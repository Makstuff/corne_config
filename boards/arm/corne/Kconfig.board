## boards/arm/corne/Kconfig.board
```kconfig
config BOARD_CORNE_LEFT
	bool "Corne Choc Pro Left"
	depends on SOC_NRF52840_QIAA

config BOARD_CORNE_RIGHT
    bool "Corne Choc Pro Right"
    depends on SOC_NRF52840_QIAA
```
